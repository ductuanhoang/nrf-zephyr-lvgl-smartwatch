/*
 * Copyright (c) 2022 Nordic Semiconductor ASA
 *
 * SPDX-License-Identifier: LicenseRef-Nordic-5-Clause
 */

/dts-v1/;
#include <nordic/nrf5340_cpuapp_qkaa.dtsi>
#include "smart_watch_nrf5340_cpuapp_common.dts"
#include "smart_watch_nrf7002dk_nrf5340_cpuapp-pinctrl.dtsi"

/ {
	model = "smart_watch_nrf7002dk_nrf5340_cpuapp";
	compatible = "smart_watch_nrf7002dk_nrf5340_cpuapp";

	chosen {
		zephyr,sram = &sram0_image;
		zephyr,flash = &flash0;
		zephyr,code-partition = &slot0_partition;
		zephyr,sram-secure-partition = &sram0_s;
		zephyr,sram-non-secure-partition = &sram0_ns;
	};
};

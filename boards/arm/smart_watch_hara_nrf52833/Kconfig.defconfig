## boards/arm/smart_watch_hara_nrf52833/Kconfig.defconfig
```kconfig
# Copyright (c) 2022 Nordic Semiconductor ASA
# SPDX-License-Identifier: Apache-2.0

if BOARD_SMART_WATCH_HARA_NRF52833

config BOARD
	default "smart_watch_hara_nrf52833"

config BT_CTLR
   default BT

endif
```

## boards/arm/smart_watch_tuan_nrf52840/Kconfig.defconfig
```kconfig
# nRF52840 DK NRF52840 board configuration

# Copyright (c) 2016 Nordic Semiconductor ASA
# SPDX-License-Identifier: Apache-2.0

if BOARD_SMART_WATCH_TUAN_NRF52840

config BOARD
	default "smart_watch_tuan_nrf52840"

config BT_CTLR
	default BT

endif # BOARD_SMART_WATCH_TUAN_NRF52840
```
